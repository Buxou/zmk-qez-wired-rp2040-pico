## boards/shields/qez/Kconfig.defconfig
```kconfig
# Copyright (c) 2020 The ZMK Contributors
# SPDX-License-Identifier: MIT


if SHIELD_QEZ

# Name must be less than 16 characters long!
config ZMK_KEYBOARD_NAME
    default "QEZ"

endif
```

## boards/shields/qez/Kconfig.shield
```kconfig
# Copyright (c) 2020 The ZMK Contributors
# SPDX-License-Identifier: MIT

config SHIELD_QEZ
    def_bool $(shields_list_contains,qez)
```
